## conf/bblayers.conf
```bitbake
# POKY_BBLAYERS_CONF_VERSION is increased each time build/conf/bblayers.conf
# changes incompatibly
POKY_BBLAYERS_CONF_VERSION = "2"

BBPATH = "${TOPDIR}"
BBFILES ?= ""

BBLAYERS ?= " \
  /home/nishant/poky/meta \
  /home/nishant/poky/meta-poky \
  /home/nishant/poky/meta-yocto-bsp \
  /home/nishant/poky/meta-mylayer \
  "
```
